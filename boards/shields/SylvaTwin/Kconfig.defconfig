## boards/shields/SylvaTwin/Kconfig.defconfig
```kconfig
if SHIELD_SylvaTwin_L
    config ZMK_KEYBOARD_NAME
        default "SylvaTwin_L"
    
    config ZMK_SPLIT_ROLE_CENTRAL
        default y

    config ZMK_SPLIT_BLE_CENTRAL_PERIPHERALS
        default 1

    config ZMK_SPLIT
        default y
endif

if SHIELD_SylvaTwin_R

    config ZMK_KEYBOARD_NAME
        default "SylvaTwin_R"
        
    config ZMK_SPLIT
        default y
endif
```

## boards/shields/SylvaTwin/Kconfig.shield
```kconfig
# Copyright (c) 2020 Pete Johanson
# SPDX-License-Identifier: MIT

config SHIELD_SylvaTwin_L
    def_bool $(shields_list_contains,SylvaTwin_L)

config SHIELD_SylvaTwin_R
    def_bool $(shields_list_contains,SylvaTwin_R)
```
