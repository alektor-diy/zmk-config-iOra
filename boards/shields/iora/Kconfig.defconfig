## boards/shields/iora/Kconfig.defconfig
```kconfig
if SHIELD_IORA_LEFT || SHIELD_IORA_RIGHT

config ZMK_KEYBOARD_NAME
    default "iOra"

config ZMK_SPLIT
    default y

endif

if SHIELD_IORA_LEFT

config ZMK_SPLIT_ROLE_CENTRAL
    default y

config ZMK_SPLIT_BLE_CENTRAL_BATTERY_LEVEL_FETCHING
    default y

config ZMK_SPLIT_BLE_CENTRAL_BATTERY_LEVEL_PROXY
    default y

endif
```

## boards/shields/iora/Kconfig.shield
```kconfig
config SHIELD_IORA_LEFT
    def_bool $(shields_list_contains,iora_left)

config SHIELD_IORA_RIGHT
    def_bool $(shields_list_contains,iora_right)
```

## config/west.yml
```yaml
manifest:
  defaults:
    revision: v0.3
  remotes:
    - name: zmkfirmware
      url-base: https://github.com/zmkfirmware
    - name: sekigon-gonnoc
      url-base: https://github.com/sekigon-gonnoc
    - name: efogdev
      url-base: https://github.com/efogdev
  projects:
    - name: zmk
      remote: zmkfirmware
      import: app/west.yml
    - name: zmk-pmw3610-driver
      remote: efogdev
      revision: 42e0a8557a3adc43231fef4234f23e530034e427
    - name: zmk-feature-non-lipo-battery-management
      remote: sekigon-gonnoc
      revision: 43fa56fb7d1e065393e926b6caa0ea02cb86eca7
    - name: zmk-satellite
      url: https://github.com/alektor-diy/zmk-satellite
      revision: b0660ff2f3784a0db54596cd660e1d6f7ea218a3
      path: modules/zmk-satellite
      import: module/west.yml
  self:
    path: config
```

## dts/bindings/behaviors/askey,auto-mouse-control.yaml
```yaml
description: Toggle auto mouse or dismiss its active layer before forwarding a binding
compatible: "askey,auto-mouse-control"
include: zero_param.yaml

properties:
  bindings:
    type: phandle-array
    description: Single fallback binding to forward after dismissing the mouse layer
```

## dts/bindings/behaviors/askey,trackball-swap.yaml
```yaml
description: Swap the iOra trackball roles and save the selection
compatible: "askey,trackball-swap"
include: zero_param.yaml
```

## dts/bindings/input_processors/askey,auto-mouse.yaml
```yaml
description: Gate the iOra automatic mouse layer on its user toggle
compatible: "askey,auto-mouse"
include: ip_zero_param.yaml

properties:
  processor:
    type: phandle-array
    specifier-space: input-processor
    required: true
    description: Temporary layer input processor with its layer and timeout parameters
```

## dts/bindings/input_processors/askey,trackball-keys.yaml
```yaml
description: Convert vertical trackball motion to keys from a Studio-editable layer
compatible: "askey,trackball-keys"
include: ip_zero_param.yaml

properties:
  layers:
    type: array
    required: true
  settings-layer:
    type: int
    required: true
  up-positions:
    type: array
    required: true
    description: One upward binding position per entry in layers
  down-positions:
    type: array
    required: true
    description: One downward binding position per entry in layers
  counts-per-tap:
    type: int
    required: true
  repeat-interval-ms:
    type: int
    required: true
```

## dts/bindings/input_processors/askey,trackball-router.yaml
```yaml
description: Route each iOra trackball through the selected role
compatible: "askey,trackball-router"
include: ip_one_param.yaml

properties:
  auxiliary-scroll:
    type: phandle-array
    specifier-space: input-processor
    required: true
  primary-scroll:
    type: phandle-array
    specifier-space: input-processor
    required: true
```
